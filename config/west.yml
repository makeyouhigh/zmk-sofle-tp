## config/west.yml
```yaml
manifest:
  remotes:
    - name: zmkfirmware
      url-base: https://github.com/zmkfirmware
      # Additional modules containing boards/shields/custom code can be listed here as well.
      # See:
      # - https://zmk.dev/docs/features/modules
      # - https://docs.zephyrproject.org/3.5.0/develop/west/manifest.html#projects
    - name: gpeye
      url-base: https://github.com/GPeye
    - name: m165437
      url-base: https://github.com/M165437
    - name: infused-kim
      url-base: https://github.com/infused-kim
    - name: badjeff
      url-base: https://github.com/badjeff
  projects:
    - name: eyelash_sofle
      url: https://github.com/a741725193/zmk-sofle
      revision: refactor
    - name: mario-peripheral-animation
      remote: gpeye
      revision: main 
    - name: zmk
      remote: zmkfirmware
      revision: main
#      remote: badjeff
#      revision: main
#      remote: infused-kim
#      revision: pr-testing/mouse_ps2_module_base
      import: app/west.yml
    - name: nice-view-gem
      remote: m165437
      revision: main
    # zmk module for PS/2 mouse / TP driver
    - name: kb_zmk_ps2_mouse_trackpoint_driver
      remote: infused-kim
      revision: main
    
  self:
    path: config
```
